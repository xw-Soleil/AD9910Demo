#include "Correct.h"
#include "app_config.h"
#include <math.h>
#include "arm_math.h" // 假设已包含
#include "utils.h"
#include "AD9910.h"
#include "process.h"
#include "sample.h"



/**
 * @brief 信号输入采样板校正
 */

float32_t SampleInBoardArr[1000] ={
    0.602511823, 0.674890578, 0.692906857, 0.700862825, 0.705134630, 0.707429588, 0.708690643, 0.709362268, 
    0.709708035, 0.710164368, 0.710611343, 0.710616410, 0.710641563, 0.709698856, 0.710060775, 0.709025562, 
    0.709610283, 0.709535122, 0.710432470, 0.709304810, 0.709393978, 0.709912002, 0.709212959, 0.709176719, 
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    0.745902717, 0.754355967, 0.749470174, 0.735896349, 0.757184029, 0.756068528, 0.751039684, 0.749622643
};
float32_t SampleInBoardErrorArr[1000] = {0}; // 用于存储采样板增益衰减幅度

void SampleInBoardCorr(){
    float32_t target_freq, target_vin;
    // float32_t measured_vout; // 不再需要单个的测量变量

    // 用于存储单次设置下的多次测量结果
    float32_t VoutMeasurements[DDS_ITERATIONS]; 
    float32_t mean_vout; // 用于存储计算出的平均值

    for (uint32_t i = 0; i < 1000; i++)
    {
        target_freq = FREQ_START + i * FREQ_STEP;
        {
            target_vin = 2.0f;

            // 1. 设置DAC输出电压，这个动作只需要执行一次
            DDSOutputCorrSamInBord(target_freq, target_vin);
            // 2. 等待电路稳定，这个延时也只需要一次
            HAL_Delay(STABILIZE_DELAY_MS);
            // 3. 进行多次测量，并将结果存入数组
            for (uint32_t k = 0; k < 3; k++)
            {
                VoutMeasurements[k] = MeasureAdcInputVpp();
                // 可以在这里加入一个极短的延时，如果ADC采样过快的话
                // HAL_Delay(1); 
            }

            // 4. 使用 ARM Math 库高效计算测量结果的平均值
            arm_mean_f32(VoutMeasurements, 3, &mean_vout);

            // 5. 使用稳定后的平均值进行计算和存储
            SampleInBoardArr[i] = mean_vout / target_vin; // 计算增益衰减幅度
        }
    }
}


void SampleInBoardError(){
    float32_t target_freq, target_vin;
    // float32_t measured_vout; // 不再需要单个的测量变量

    // 用于存储单次设置下的多次测量结果
    float32_t VoutMeasurements[MAX_ITERATIONS]; 
    float32_t mean_vout; // 用于存储计算出的平均值

    for (uint32_t i = 0; i < 1000; i++)
    {
        target_freq = FREQ_START + i * FREQ_STEP;
        {
            target_vin = 2.0f;

            // 1. 设置DAC输出电压，这个动作只需要执行一次
            DDSOutputCorrSamInBord(target_freq, target_vin);
            // 2. 等待电路稳定，这个延时也只需要一次
            HAL_Delay(STABILIZE_DELAY_MS);
            // 3. 进行多次测量，并将结果存入数组
            for (uint32_t k = 0; k < 3; k++)
            {
                VoutMeasurements[k] = MeasureAdcInputVpp();
                // 可以在这里加入一个极短的延时，如果ADC采样过快的话
                // HAL_Delay(1); 
            }

            // 4. 使用 ARM Math 库高效计算测量结果的平均值
            arm_mean_f32(VoutMeasurements, 3, &mean_vout);

            // 5. 使用稳定后的平均值进行计算和存储
            SampleInBoardErrorArr[i] = mean_vout / (target_vin * SampleInBoardArr[i]); // 计算增益衰减幅度
        }
    }
}


/**
 * @brief ADC采样输入校正
 */
float32_t ADCSampleInputCorr(float32_t freqHz, float32_t vpp){
    uint16_t i;
    i = (uint16_t)((freqHz - FREQ_START) / FREQ_STEP);
    if(i < 1000){
        vpp  = vpp / SampleInBoardArr[i];  // 这里假设只使用第一个通道的增益
    }
    return vpp;
}